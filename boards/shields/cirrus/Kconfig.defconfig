## boards/shields/cirrus/Kconfig.defconfig
```kconfig
if SHIELD_CIRRUS_LEFT

config ZMK_KEYBOARD_NAME
    default "Cirrus"

config ZMK_SPLIT_ROLE_CENTRAL
    default y

endif

if SHIELD_CIRRUS_LEFT || SHIELD_CIRRUS_RIGHT

config ZMK_SPLIT
    default y

endif
```

## boards/shields/cirrus/Kconfig.shield
```kconfig
config SHIELD_CIRRUS_LEFT
    def_bool $(shields_list_contains,cirrus_left)

config SHIELD_CIRRUS_RIGHT
    def_bool $(shields_list_contains,cirrus_right)
```
